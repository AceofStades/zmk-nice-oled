/*
 * Copyright (c) 2024 ZMK
 *
 * SPDX-License-Identifier: MIT
 */

&nice_view_spi {
	status = "okay";
	nice_peri_view: ls0xx@0 {
		compatible = "sharp,ls0xx";
		label = "DISPLAY";
		spi-max-frequency = <2000000>;
		reg = <0>;
		width = <160>;
		height = <68>;
	};
};

/ {
  chosen {
    zephyr,display = &nice_peri_view;
  };
};
